## Kconfig
```kconfig
# Copyright (c) 2024 Felipe Neves
# SPDX-License-Identifier: Apache-2.0

config ZIPM
    bool "Enables Zephyr Inter-Processor Messaging"
    help
      Enables Zephyr Inter-Processor Messaging module
```

## dts/bindings/zipm-message-device.yaml
```yaml
# Copyright (c) 2024 Felipe Neves
# SPDX-License-Identifier: Apache-2.0

description: |
  Zephyr Inter Processor Message device descriptor. Example usage:

    &shared_ram {

      #address-cells = <1>;
      #size-cells = <0>;

      zipm_device: zipm_device {
        compatible = "zipm,message-device";
        status = "okay";
        node-pool = <&zipm_pool>;
        shared-queues = <&zipm_tx_queue &zipm_rx_queue>;
        ipc = <&ipm0>;
        should-init = <true>;
      };

      zipm_pool: zipm_pool@0 {
        compatible = "zipm,node-pool";
        block-size = <32>;
        nodes-quantity = <16>;
        reg = <0x0>;
      };

      zipm_tx_queue: zipm_tx_queue@800 {
        compatible = "zipm,shared-queue";
        reg = <0x800>;
       };

      zipm_rx_queue: zipm_rx_queue@c00 {
        compatible = "zipm,shared-queue";
        reg = <0xc00>;
      };

    };

compatible: "zipm,message-device"

properties:
  node-pool:
    required: true
    type: phandle
    description: |
      node pool object reference
  
  shared-queues:
    required: true
    type: phandles
    description: |
      one or more shared queues reference

  ipc:
    required: true
    type: phandle
    description: |
      reference to the cross-core device node
  
  should-init:
    type: boolean
    description: |
      if present this zipm device should also
      initialize the shared memory area.

include: [base.yaml]
```

## dts/bindings/zipm-node-pool.yaml
```yaml
# Copyright (c) 2024 Felipe Neves
# SPDX-License-Identifier: Apache-2.0

description: |
  Zephyr Inter Processor Message memory pool descriptor. Example usage:

    &shared_ram {

      #address-cells = <1>;
      #size-cells = <0>;

      zipm_pool: zipm_pool@0 {
        compatible = "zipm,node-pool";
        block-size = <32>;
        nodes-quantity = <16>;
        reg = <0x0>;
      };
    };

compatible: "zipm,node-pool"

properties:
  block-size:
    required: true
    type: int
    description: |
      Size in bytes of the memory block per node
  
  nodes-quantity:
    required: true
    type: int
    description: |
      Number of nodes available in the current pool

include: [base.yaml]
```

## dts/bindings/zipm-shared-queue.yml
```yaml
# Copyright (c) 2024 Felipe Neves
# SPDX-License-Identifier: Apache-2.0

description: |
  Zephyr Inter Processor Message shared queue. Example usage for a

    &shared_ram {
      #address-cells = <1>;
      #size-cells = <0>;

      zipm_tx_queue: zipm_tx_queue@800 {
        compatible = "zipm,shared-queue";
        reg = <0x800>;
       };

      zipm_rx_queue: zipm_rx_queue@c00 {
        compatible = "zipm,shared-queue";
        reg = <0xc00>;
      };
    };

compatible: "zipm,shared-queue"

include: [base.yaml]
```

## west.yml
```yaml
# Copyright (c) 2024 Felipe Neves
# SPDX-License-Identifier: Apache-2.0

manifest:
  self:
    path: lkmotor_mf4005_driver

  remotes:
    - name: zephyr
      url-base: https://github.com/zephyrproject-rtos

  projects:
    - name: zephyr
      remote: zephyr
      repo-path: zephyr
      revision: main
```
